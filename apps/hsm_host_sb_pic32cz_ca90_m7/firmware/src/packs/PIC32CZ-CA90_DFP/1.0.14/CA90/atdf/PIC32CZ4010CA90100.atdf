# PIC32CZ4010CA90100 device description
Architecture: CORTEX-M7; Family: PIC32C; Series: PIC32CZCA90

## Interrupts
-15 Reset — Reset Vector, invoked on Power up and warm reset
-14 NonMaskableInt — Non maskable Interrupt, cannot be stopped or preempted
-13 HardFault — Hard Fault, all classes of Fault
-12 MemoryManagement — Memory Management, MPU mismatch, including Access Violation and No Match
-11 BusFault — Bus Fault, Pre-Fetch-, Memory Access Fault, other address/memory related Fault
-10 UsageFault — Usage Fault, i.e. Undef Instruction, Illegal State Transition
-5 SVCall — System Service Call via SVC instruction
-4 DebugMonitor
-2 PendSV — Pendable request for system service
-1 SysTick — System Tick Timer
0 FCW — Flash Write Controller Interrupt
1 FCR_ECCERR (FCR) — Flash Read Controller ECC Error
2 FCR_CRC_FAULT (FCR) — Flash Read Controller CRC Fault
3 PM — Power Manager
4 SUPC — Supply Controller
5 OSCCTRL_FAIL (OSCCTRL) — External Oscillator Fail
6 OSCCTRL_XOSCRDY (OSCCTRL) — External Oscillator Ready
7 OSCCTRL_DFLLRDY (OSCCTRL) — DFLL Ready
8 OSCCTRL_OTHER (OSCCTRL) — DFLL Other Interrupt
9 OSCCTRL_LOCK (OSCCTRL) — PLL Lock
10 OSC32KCTRL_FAIL (OSC32KCTRL) — 32K Oscillator Fail
11 OSC32KCTRL_RDY (OSC32KCTRL) — 32K Oscillator Ready
12 MCLK — Main Clock
13 FREQM — Frequency Meter
14 WDT — Watchdog Timer
15 RTC_TAMPER (RTC)
16 RTC_OVF (RTC) — RTC Overflow
17 RTC_PERIOD (RTC)
18 RTC_COMPARE (RTC)
{n+19} EIC_EXTINT_{n} (EIC) (n=0..15) — External Interrupt {n}
35 PAC — Peripheral Access Controller
36 DRMTCM — TCM RAM ECC Interrupt
37 MCRAMC — Multi-Channel RAM Controller
38 TRAM — Trust RAM Interrupt
39 DMA_PRI3 (DMA) — DMA Priority 3 Interrupt
40 DMA_PRI2 (DMA) — DMA Priority 2 Interrupt
41 DMA_PRI1 (DMA) — DMA Priority 1 Interrupt
42 DMA_PRI0 (DMA) — DMA Priority 0 Interrupt
43 EVSYS_0 (EVSYS) — Event System InterruptChannel 0
{n+43} EVSYS_{n} (EVSYS) (n=1..11) — Event System Channel {n}
55 SERCOM0_6 (SERCOM0) — USART/SPI/I2C Error
56 SERCOM0_5 (SERCOM0) — USART Receive Break
57 SERCOM0_0 (SERCOM0) — USART-SPI Data Register Empty/ I2C Stop Received
58 SERCOM0_1 (SERCOM0) — USART-SPI Transmit Complete/ I2C Address Match
59 SERCOM0_2 (SERCOM0) — USART-SPI Receive Complete/ I2C Data Ready
60 SERCOM0_3 (SERCOM0) — USART Receive Start/ SPI Slave Select Low/ I2C TX FIFO Empty
61 SERCOM0_4 (SERCOM0) — USART Clear To Send Input Change/ I2C RX FIFO Full
62 SERCOM1_6 (SERCOM1) — USART/SPI/I2C Error
63 SERCOM1_5 (SERCOM1) — USART Receive Break
64 SERCOM1_0 (SERCOM1) — USART-SPI Data Register Empty/ I2C Stop Received
65 SERCOM1_1 (SERCOM1) — USART-SPI Transmit Complete/ I2C Address Match
66 SERCOM1_2 (SERCOM1) — USART-SPI Receive Complete/ I2C Data Ready
67 SERCOM1_3 (SERCOM1) — USART Receive Start/ SPI Slave Select Low/ I2C TX FIFO Empty
68 SERCOM1_4 (SERCOM1) — USART Clear To Send Input Change/ I2C RX FIFO Full
69 SERCOM2_6 (SERCOM2) — USART/SPI/I2C Error
70 SERCOM2_5 (SERCOM2) — USART Receive Break
71 SERCOM2_0 (SERCOM2) — USART-SPI Data Register Empty/ I2C Stop Received
72 SERCOM2_1 (SERCOM2) — USART-SPI Transmit Complete/ I2C Address Match
73 SERCOM2_2 (SERCOM2) — USART-SPI Receive Complete/ I2C Data Ready
74 SERCOM2_3 (SERCOM2) — USART Receive Start/ SPI Slave Select Low/ I2C TX FIFO Empty
75 SERCOM2_4 (SERCOM2) — USART Clear To Send Input Change/ I2C RX FIFO Full
76 SERCOM3_6 (SERCOM3) — USART/SPI/I2C Error
77 SERCOM3_5 (SERCOM3) — USART Receive Break
78 SERCOM3_0 (SERCOM3) — USART-SPI Data Register Empty/ I2C Stop Received
79 SERCOM3_1 (SERCOM3) — USART-SPI Transmit Complete/ I2C Address Match
80 SERCOM3_2 (SERCOM3) — USART-SPI Receive Complete/ I2C Data Ready
81 SERCOM3_3 (SERCOM3) — USART Receive Start/ SPI Slave Select Low/ I2C TX FIFO Empty
82 SERCOM3_4 (SERCOM3) — USART Clear To Send Input Change/ I2C RX FIFO Full
125 TCC0_OTHER (TCC0) — Error/Overflow/Underflow/Fault Interrupt
126 TCC0_CNT_TRIG (TCC0) — Counter/Re-Trigger Interrupt
{n+127} TCC0_MC{n} (TCC0) (n=0..7) — TCC Match/Compare {n}
135 TCC1_OTHER (TCC1) — Error/Overflow/Underflow/Fault Interrupt
136 TCC1_CNT_TRIG (TCC1) — Counter/Re-Trigger Interrupt
{n+137} TCC1_MC{n} (TCC1) (n=0..7) — TCC Match/Compare {n}
145 TCC2_OTHER (TCC2) — Error/Overflow/Underflow/Fault Interrupt
146 TCC2_CNT_TRIG (TCC2) — Counter/Re-Trigger Interrupt
147 TCC2_MC0 (TCC2) — TCC Match/Compare 0
148 TCC2_MC1 (TCC2) — TCC Match/Compare 1
149 TCC2_MC2 (TCC2) — TCC Match/Compare 2
150 TCC2_MC3 (TCC2) — TCC Match/Compare 3
151 TCC2_MC4 (TCC2) — TCC Match/Compare 4
152 TCC2_MC5 (TCC2) — TCC Match/Compare 5
153 TCC3_OTHER (TCC3) — Error/Overflow/Underflow/Fault Interrupt
154 TCC3_CNT_TRIG (TCC3) — Counter/Re-Trigger Interrupt
155 TCC3_MC0 (TCC3) — TCC Match/Compare 0
156 TCC3_MC1 (TCC3) — TCC Match/Compare 1
157 TCC4_OTHER (TCC4) — Error/Overflow/Underflow/Fault Interrupt
158 TCC4_CNT_TRIG (TCC4) — Counter/Re-Trigger Interrupt
159 TCC4_MC0 (TCC4) — TCC Match/Compare 0
160 TCC4_MC1 (TCC4) — TCC Match/Compare 1
161 TCC5_OTHER (TCC5) — Error/Overflow/Underflow/Fault Interrupt
162 TCC5_CNT_TRIG (TCC5) — Counter/Re-Trigger Interrupt
163 TCC5_MC0 (TCC5) — TCC Match/Compare 0
164 TCC5_MC1 (TCC5) — TCC Match/Compare 1
165 TCC6_OTHER (TCC6) — Error/Overflow/Underflow/Fault Interrupt
166 TCC6_CNT_TRIG (TCC6) — Counter/Re-Trigger Interrupt
167 TCC6_MC0 (TCC6) — TCC Match/Compare 0
168 TCC6_MC1 (TCC6) — TCC Match/Compare 1
169 TCC7_OTHER (TCC7) — Error/Overflow/Underflow/Fault Interrupt
170 TCC7_CNT_TRIG (TCC7) — Counter/Re-Trigger Interrupt
171 TCC7_MC0 (TCC7) — TCC Match/Compare 0
172 TCC7_MC1 (TCC7) — TCC Match/Compare 1
173 TCC8_OTHER (TCC8) — Error/Overflow/Underflow/Fault Interrupt
174 TCC8_CNT_TRIG (TCC8) — Counter/Re-Trigger Interrupt
175 TCC8_MC0 (TCC8) — TCC Match/Compare 0
176 TCC8_MC1 (TCC8) — TCC Match/Compare 1
177 TCC9_OTHER (TCC9) — Error/Overflow/Underflow/Fault Interrupt
178 TCC9_CNT_TRIG (TCC9) — Counter/Re-Trigger Interrupt
179 TCC9_MC0 (TCC9) — TCC Match/Compare 0
180 TCC9_MC1 (TCC9) — TCC Match/Compare 1
181 TCC9_MC2 (TCC9) — TCC Match/Compare 2
182 TCC9_MC3 (TCC9) — TCC Match/Compare 3
183 TCC9_MC4 (TCC9) — TCC Match/Compare 4
184 TCC9_MC5 (TCC9) — TCC Match/Compare 5
185 ADC_GLOBAL (ADC) — ADC Global Interrupt
186 ADC_CORE1 (ADC) — ADC Core 1 Interrupt
187 ADC_CORE2 (ADC) — ADC Core 2 Interrupt
188 ADC_CORE3 (ADC) — ADC Core 3 Interrupt
189 ADC_CORE4 (ADC) — ADC Core 4 Interrupt
190 AC — Analog Comparator Interrupt
191 PTC — Peripheral Touch Controller
192 SPI_IXS0 — Audio SPI Interrupt 0
194 CAN0 — Controller Area Network 0
195 CAN1 — Controller Area Network 1
202 ETH_PRI_Q_0 (ETH) — Ethernet MAC Interrupt
203 ETH_PRI_Q_1 (ETH) — Ethernet MAC Queue 1 Interrupt
204 ETH_PRI_Q_2 (ETH) — Ethernet MAC Queue 2 Interrupt
205 ETH_PRI_Q_3 (ETH) — Ethernet MAC Queue 3 Interrupt
206 ETH_PRI_Q_4 (ETH) — Ethernet MAC Queue 4 Interrupt
207 ETH_PRI_Q_5 (ETH) — Ethernet MAC Queue 5 Interrupt
208 SQI0 — Quad SPI Interrupt 0
210 TRNG — True Random Generator
211 SDMMC0 — SD/MMC Host Controller Interrupt 0
213 USBHS0 — High Speed USB Interrupt 0
215 HSM_TAMPER (HSM) — Hardware Security Module Tamper Interrupt
216 HSM_TXINT (HSM) — Hardware Security Module Transmit Interrupt
217 HSM_RXINT (HSM) — Hardware Security Module Receive Interrupt
218 MLB_GENERAL (MLB) — Media Local Bus General Interrupt
219 MLB_BUSREQ (MLB) — Media Local Bus Request Interrupt
220 CM7H_CTIIRQ_0 (CM7H) — Cross Trigger Interface Interrupt 0
221 CM7H_CTIIRQ_1 (CM7H) — Cross Trigger Interface Interrupt 1

## Event generators
1 SUPC_LVDET, 2 OSCCTRL_XOSC_FAIL, 3 OSC32KCTRL_XOSC32K_FAIL, 4 FREQM_DONE, 5 FREQM_WINMON, {n+6} RTC_PER_{n} (n=0..7), {n+14} RTC_CMP_{n} (n=0..3), 18 RTC_TAMPER, 19 RTC_OVF, 20 RTC_PERD, {n+21} EIC_EXTINT_{n} (n=0..15), 37 PAC_ACCERR, {n+38} DMA_CH_{n} (n=0..15), {11n+54} TCC{n}_OVF (n=0..2), {11n+55} TCC{n}_TRG (n=0..2), {11n+56} TCC{n}_CNT (n=0..2), {11n+57} TCC{n}_MC_0 (n=0..2), {11n+58} TCC{n}_MC_1 (n=0..2), {11n+59} TCC{n}_MC_2 (n=0..2), {11n+60} TCC{n}_MC_3 (n=0..2), {11n+61} TCC{n}_MC_4 (n=0..2), {11n+62} TCC{n}_MC_5 (n=0..2), 63 TCC0_MC_6, 64 TCC0_MC_7, 74 TCC1_MC_6, 75 TCC1_MC_7, {5n+70} TCC{n}_OVF (n=3..9), {5n+71} TCC{n}_TRG (n=3..9), {5n+72} TCC{n}_CNT (n=3..9), {5n+73} TCC{n}_MC_0 (n=3..9), {5n+74} TCC{n}_MC_1 (n=3..9), 120 TCC9_MC_2, 121 TCC9_MC_3, 122 TCC9_MC_4, 123 TCC9_MC_5, {n+124} ADC_CHRDYC_{n} (n=0..3), {n+128} ADC_CMP_{n} (n=0..3), 132 AC_COMP_0, 133 AC_COMP_1, 134 AC_WIN_0, 135 PTC_EOC, 136 PTC_WCOMP, 137 ETH_TSU_CMP, 138 TRNG_READY

## Event users
0 FREQM_START, 1 RTC_TAMPER, {n+2} PORT_EV_{n} (n=0..3), {n+6} DMA_CHSTRT_{n} (n=0..15), {n+22} DMA_CHAUX_{n} (n=0..15), {10n+38} TCC{n}_EV_0 (n=0..2), {10n+39} TCC{n}_EV_1 (n=0..2), {10n+40} TCC{n}_MC_0 (n=0..2), {10n+41} TCC{n}_MC_1 (n=0..2), {10n+42} TCC{n}_MC_2 (n=0..2), {10n+43} TCC{n}_MC_3 (n=0..2), {10n+44} TCC{n}_MC_4 (n=0..2), {10n+45} TCC{n}_MC_5 (n=0..2), 46 TCC0_MC_6, 47 TCC0_MC_7, 56 TCC1_MC_6, 57 TCC1_MC_7, {4n+54} TCC{n}_EV_0 (n=3..9), {4n+55} TCC{n}_EV_1 (n=3..9), {4n+56} TCC{n}_MC_0 (n=3..9), {4n+57} TCC{n}_MC_1 (n=3..9), 94 TCC9_MC_2, 95 TCC9_MC_3, 96 TCC9_MC_4, 97 TCC9_MC_5, {n+98} ADC_TRIGGERS_{n} (n=0..10), 109 AC_SOC_0, 110 AC_SOC_1, 111 PTC_DSEQR, 112 PTC_STCONV, {n+113} HSM_TAMPER_{n} (n=0..3)

## Properties
SIGNATURES: DSU_DID=0x09216053

## Pinouts (pin number, pad)
PIC32CZCA100N: 1 PA00, 2 PA01, 3 PA02, 4 PA03, 5 PA04, 6 GND, 7 VDDIO, 8 PA05, 9 PA06, 10 PA07, 11 PA08, 12 PA09, 13 PA10, 14 PA11, 15 PA12, 16 PA13, 17 PA14, 18 PA15, 19 GND, 20 VDDIO, 21 PA16, 22 PA17, 23 PA18, 24 PA19, 25 PA20, 26 PB00, 27 PB01, 28 PB02, 29 PB03, 30 AVSS, 31 AVDD, 32 PB04, 33 PB05, 34 VDDIO, 35 GND, 36 PB06, 37 PB07, 38 PB08, 39 PB09, 40 PB10, 41 PB11, 42 PB12, 43 VDDREG, 44 GND, 45 VDDIO, 46 PB13, 47 PB14, 48 PB15, 49 PB16, 50 PB17, 51 PC00, 52 PC01, 53 PC02, 54 PC03, 55 PC04, 56 VDDF, 57 VSSF2, 58 PC05, 59 PC06, 60 PC07, 61 PC08, 62 PC09, 63 PC10, 64 PC11, 65 PC12, 66 PC13, 67 PC14, 68 PC15, 69 VDDF, 70 VSSF1, 71 RESET_N, 72 PC17, 73 PC18, 74 PC19, 75 PC20, 76 USBDP0, 77 USBDM0, 78 USBID0, 79 VCCA3P30, 80 VSSUSBA, 81 VBUS0, 82 USBRBIAS0, 83 GND, 84 VDDREG, 85 PD00, 86 PD01, 87 PD02, 88 PD03, 89 PD04, 90 PD05, 91 PD06, 92 PD07, 93 VDDREG, 94 GND, 95 VDDIO, 96 PD08, 97 PD09, 98 PD10, 99 PD11, 100 PD12
PIC32CZCA100: 1 PA00, 2 PA01, 3 PA02, 4 PA03, 5 PA04, 6 GND, 7 VDDIO, 8 PA05, 9 PA06, 10 PA07, 11 PA08, 12 PA09, 13 PA10, 14 PA11, 15 PA12, 16 PA13, 17 PA14, 18 PA15, 19 GND, 20 VDDIO, 21 PA16, 22 PA17, 23 PA18, 24 PA19, 25 PA20, 26 PB00, 27 PB01, 28 PB02, 29 PB03, 30 AVSS, 31 AVDD, 32 PB04, 33 PB05, 34 VDDIO, 35 GND, 36 PB06, 37 PB07, 38 PB08, 39 PB09, 40 PB10, 41 PB11, 42 PB12, 43 VDDREG, 44 GND, 45 VDDIO, 46 PB13, 47 PB14, 48 PB15, 49 PB16, 50 PB17, 51 PC00, 52 PC01, 53 PC02, 54 PC03, 55 PC04, 56 VDDF, 57 VSSF2, 58 PC05, 59 PC06, 60 PC07, 61 PC08, 62 PC09, 63 PC10, 64 PC11, 65 PC12, 66 PC13, 67 PC14, 68 PC15, 69 VDDF, 70 VSSF1, 71 RESET_N, 72 PC17, 73 PC18, 74 PC19, 75 PC20, 76 USBDM0, 77 USBDP0, 78 USBID0, 79 VCCA3P30, 80 VSSUSBA, 81 VBUS0, 82 USBRBIAS0, 83 GND, 84 VDDREG, 85 PD00, 86 PD01, 87 PD02, 88 PD03, 89 PD04, 90 PD05, 91 PD06, 92 PD07, 93 VDDREG, 94 GND, 95 VDDIO, 96 PD08, 97 PD09, 98 PD10, 99 PD11, 100 PD12

## Notices in the file
Copyright (c) 2021 Microchip Technology Inc.
SPDX-License-Identifier: Apache-2.0
Licensed under the Apache License, Version 2.0 (the "License");
you may not use this file except in compliance with the License.
You may obtain a copy of the License at
http://www.apache.org/licenses/LICENSE-2.0
Unless required by applicable law or agreed to in writing, software
distributed under the License is distributed on an "AS IS" BASIS,
WITHOUT WARRANTIES OR CONDITIONS OF ANY KIND, either express or implied.
See the License for the specific language governing permissions and
limitations under the License.
