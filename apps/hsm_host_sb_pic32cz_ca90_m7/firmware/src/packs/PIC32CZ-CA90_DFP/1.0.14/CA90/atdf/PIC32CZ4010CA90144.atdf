# PIC32CZ4010CA90144 device description
Architecture: CORTEX-M7; Family: PIC32C; Series: PIC32CZCA90

## Interrupts
-15 Reset — Reset Vector, invoked on Power up and warm reset
-14 NonMaskableInt — Non maskable Interrupt, cannot be stopped or preempted
-13 HardFault — Hard Fault, all classes of Fault
-12 MemoryManagement — Memory Management, MPU mismatch, including Access Violation and No Match
-11 BusFault — Bus Fault, Pre-Fetch-, Memory Access Fault, other address/memory related Fault
-10 UsageFault — Usage Fault, i.e. Undef Instruction, Illegal State Transition
-5 SVCall — System Service Call via SVC instruction
-4 DebugMonitor
-2 PendSV — Pendable request for system service
-1 SysTick — System Tick Timer
0 FCW — Flash Write Controller Interrupt
1 FCR_ECCERR (FCR) — Flash Read Controller ECC Error
2 FCR_CRC_FAULT (FCR) — Flash Read Controller CRC Fault
3 PM — Power Manager
4 SUPC — Supply Controller
5 OSCCTRL_FAIL (OSCCTRL) — External Oscillator Fail
6 OSCCTRL_XOSCRDY (OSCCTRL) — External Oscillator Ready
7 OSCCTRL_DFLLRDY (OSCCTRL) — DFLL Ready
8 OSCCTRL_OTHER (OSCCTRL) — DFLL Other Interrupt
9 OSCCTRL_LOCK (OSCCTRL) — PLL Lock
10 OSC32KCTRL_FAIL (OSC32KCTRL) — 32K Oscillator Fail
11 OSC32KCTRL_RDY (OSC32KCTRL) — 32K Oscillator Ready
12 MCLK — Main Clock
13 FREQM — Frequency Meter
14 WDT — Watchdog Timer
15 RTC_TAMPER (RTC)
16 RTC_OVF (RTC) — RTC Overflow
17 RTC_PERIOD (RTC)
18 RTC_COMPARE (RTC)
{n+19} EIC_EXTINT_{n} (EIC) (n=0..15) — External Interrupt {n}
35 PAC — Peripheral Access Controller
36 DRMTCM — TCM RAM ECC Interrupt
37 MCRAMC — Multi-Channel RAM Controller
38 TRAM — Trust RAM Interrupt
39 DMA_PRI3 (DMA) — DMA Priority 3 Interrupt
40 DMA_PRI2 (DMA) — DMA Priority 2 Interrupt
41 DMA_PRI1 (DMA) — DMA Priority 1 Interrupt
42 DMA_PRI0 (DMA) — DMA Priority 0 Interrupt
43 EVSYS_0 (EVSYS) — Event System InterruptChannel 0
{n+43} EVSYS_{n} (EVSYS) (n=1..11) — Event System Channel {n}
55 SERCOM0_6 (SERCOM0) — USART/SPI/I2C Error
56 SERCOM0_5 (SERCOM0) — USART Receive Break
57 SERCOM0_0 (SERCOM0) — USART-SPI Data Register Empty/ I2C Stop Received
58 SERCOM0_1 (SERCOM0) — USART-SPI Transmit Complete/ I2C Address Match
59 SERCOM0_2 (SERCOM0) — USART-SPI Receive Complete/ I2C Data Ready
60 SERCOM0_3 (SERCOM0) — USART Receive Start/ SPI Slave Select Low/ I2C TX FIFO Empty
61 SERCOM0_4 (SERCOM0) — USART Clear To Send Input Change/ I2C RX FIFO Full
62 SERCOM1_6 (SERCOM1) — USART/SPI/I2C Error
63 SERCOM1_5 (SERCOM1) — USART Receive Break
64 SERCOM1_0 (SERCOM1) — USART-SPI Data Register Empty/ I2C Stop Received
65 SERCOM1_1 (SERCOM1) — USART-SPI Transmit Complete/ I2C Address Match
66 SERCOM1_2 (SERCOM1) — USART-SPI Receive Complete/ I2C Data Ready
67 SERCOM1_3 (SERCOM1) — USART Receive Start/ SPI Slave Select Low/ I2C TX FIFO Empty
68 SERCOM1_4 (SERCOM1) — USART Clear To Send Input Change/ I2C RX FIFO Full
69 SERCOM2_6 (SERCOM2) — USART/SPI/I2C Error
70 SERCOM2_5 (SERCOM2) — USART Receive Break
71 SERCOM2_0 (SERCOM2) — USART-SPI Data Register Empty/ I2C Stop Received
72 SERCOM2_1 (SERCOM2) — USART-SPI Transmit Complete/ I2C Address Match
73 SERCOM2_2 (SERCOM2) — USART-SPI Receive Complete/ I2C Data Ready
74 SERCOM2_3 (SERCOM2) — USART Receive Start/ SPI Slave Select Low/ I2C TX FIFO Empty
75 SERCOM2_4 (SERCOM2) — USART Clear To Send Input Change/ I2C RX FIFO Full
76 SERCOM3_6 (SERCOM3) — USART/SPI/I2C Error
77 SERCOM3_5 (SERCOM3) — USART Receive Break
78 SERCOM3_0 (SERCOM3) — USART-SPI Data Register Empty/ I2C Stop Received
79 SERCOM3_1 (SERCOM3) — USART-SPI Transmit Complete/ I2C Address Match
80 SERCOM3_2 (SERCOM3) — USART-SPI Receive Complete/ I2C Data Ready
81 SERCOM3_3 (SERCOM3) — USART Receive Start/ SPI Slave Select Low/ I2C TX FIFO Empty
82 SERCOM3_4 (SERCOM3) — USART Clear To Send Input Change/ I2C RX FIFO Full
83 SERCOM4_6 (SERCOM4) — USART/SPI/I2C Error
84 SERCOM4_5 (SERCOM4) — USART Receive Break
85 SERCOM4_0 (SERCOM4) — USART-SPI Data Register Empty/ I2C Stop Received
86 SERCOM4_1 (SERCOM4) — USART-SPI Transmit Complete/ I2C Address Match
87 SERCOM4_2 (SERCOM4) — USART-SPI Receive Complete/ I2C Data Ready
88 SERCOM4_3 (SERCOM4) — USART Receive Start/ SPI Slave Select Low/ I2C TX FIFO Empty
89 SERCOM4_4 (SERCOM4) — USART Clear To Send Input Change/ I2C RX FIFO Full
90 SERCOM5_6 (SERCOM5) — USART/SPI/I2C Error
91 SERCOM5_5 (SERCOM5) — USART Receive Break
92 SERCOM5_0 (SERCOM5) — USART-SPI Data Register Empty/ I2C Stop Received
93 SERCOM5_1 (SERCOM5) — USART-SPI Transmit Complete/ I2C Address Match
94 SERCOM5_2 (SERCOM5) — USART-SPI Receive Complete/ I2C Data Ready
95 SERCOM5_3 (SERCOM5) — USART Receive Start/ SPI Slave Select Low/ I2C TX FIFO Empty
96 SERCOM5_4 (SERCOM5) — USART Clear To Send Input Change/ I2C RX FIFO Full
125 TCC0_OTHER (TCC0) — Error/Overflow/Underflow/Fault Interrupt
126 TCC0_CNT_TRIG (TCC0) — Counter/Re-Trigger Interrupt
{n+127} TCC0_MC{n} (TCC0) (n=0..7) — TCC Match/Compare {n}
135 TCC1_OTHER (TCC1) — Error/Overflow/Underflow/Fault Interrupt
136 TCC1_CNT_TRIG (TCC1) — Counter/Re-Trigger Interrupt
{n+137} TCC1_MC{n} (TCC1) (n=0..7) — TCC Match/Compare {n}
145 TCC2_OTHER (TCC2) — Error/Overflow/Underflow/Fault Interrupt
146 TCC2_CNT_TRIG (TCC2) — Counter/Re-Trigger Interrupt
147 TCC2_MC0 (TCC2) — TCC Match/Compare 0
148 TCC2_MC1 (TCC2) — TCC Match/Compare 1
149 TCC2_MC2 (TCC2) — TCC Match/Compare 2
150 TCC2_MC3 (TCC2) — TCC Match/Compare 3
151 TCC2_MC4 (TCC2) — TCC Match/Compare 4
152 TCC2_MC5 (TCC2) — TCC Match/Compare 5
153 TCC3_OTHER (TCC3) — Error/Overflow/Underflow/Fault Interrupt
154 TCC3_CNT_TRIG (TCC3) — Counter/Re-Trigger Interrupt
155 TCC3_MC0 (TCC3) — TCC Match/Compare 0
156 TCC3_MC1 (TCC3) — TCC Match/Compare 1
157 TCC4_OTHER (TCC4) — Error/Overflow/Underflow/Fault Interrupt
158 TCC4_CNT_TRIG (TCC4) — Counter/Re-Trigger Interrupt
159 TCC4_MC0 (TCC4) — TCC Match/Compare 0
160 TCC4_MC1 (TCC4) — TCC Match/Compare 1
161 TCC5_OTHER (TCC5) — Error/Overflow/Underflow/Fault Interrupt
162 TCC5_CNT_TRIG (TCC5) — Counter/Re-Trigger Interrupt
163 TCC5_MC0 (TCC5) — TCC Match/Compare 0
164 TCC5_MC1 (TCC5) — TCC Match/Compare 1
165 TCC6_OTHER (TCC6) — Error/Overflow/Underflow/Fault Interrupt
166 TCC6_CNT_TRIG (TCC6) — Counter/Re-Trigger Interrupt
167 TCC6_MC0 (TCC6) — TCC Match/Compare 0
168 TCC6_MC1 (TCC6) — TCC Match/Compare 1
169 TCC7_OTHER (TCC7) — Error/Overflow/Underflow/Fault Interrupt
170 TCC7_CNT_TRIG (TCC7) — Counter/Re-Trigger Interrupt
171 TCC7_MC0 (TCC7) — TCC Match/Compare 0
172 TCC7_MC1 (TCC7) — TCC Match/Compare 1
173 TCC8_OTHER (TCC8) — Error/Overflow/Underflow/Fault Interrupt
174 TCC8_CNT_TRIG (TCC8) — Counter/Re-Trigger Interrupt
175 TCC8_MC0 (TCC8) — TCC Match/Compare 0
176 TCC8_MC1 (TCC8) — TCC Match/Compare 1
177 TCC9_OTHER (TCC9) — Error/Overflow/Underflow/Fault Interrupt
178 TCC9_CNT_TRIG (TCC9) — Counter/Re-Trigger Interrupt
179 TCC9_MC0 (TCC9) — TCC Match/Compare 0
180 TCC9_MC1 (TCC9) — TCC Match/Compare 1
181 TCC9_MC2 (TCC9) — TCC Match/Compare 2
182 TCC9_MC3 (TCC9) — TCC Match/Compare 3
183 TCC9_MC4 (TCC9) — TCC Match/Compare 4
184 TCC9_MC5 (TCC9) — TCC Match/Compare 5
185 ADC_GLOBAL (ADC) — ADC Global Interrupt
186 ADC_CORE1 (ADC) — ADC Core 1 Interrupt
187 ADC_CORE2 (ADC) — ADC Core 2 Interrupt
188 ADC_CORE3 (ADC) — ADC Core 3 Interrupt
189 ADC_CORE4 (ADC) — ADC Core 4 Interrupt
190 AC — Analog Comparator Interrupt
191 PTC — Peripheral Touch Controller
192 SPI_IXS0 — Audio SPI Interrupt 0
194 CAN0 — Controller Area Network 0
195 CAN1 — Controller Area Network 1
196 CAN2 — Controller Area Network 2
197 CAN3 — Controller Area Network 3
202 ETH_PRI_Q_0 (ETH) — Ethernet MAC Interrupt
203 ETH_PRI_Q_1 (ETH) — Ethernet MAC Queue 1 Interrupt
204 ETH_PRI_Q_2 (ETH) — Ethernet MAC Queue 2 Interrupt
205 ETH_PRI_Q_3 (ETH) — Ethernet MAC Queue 3 Interrupt
206 ETH_PRI_Q_4 (ETH) — Ethernet MAC Queue 4 Interrupt
207 ETH_PRI_Q_5 (ETH) — Ethernet MAC Queue 5 Interrupt
208 SQI0 — Quad SPI Interrupt 0
210 TRNG — True Random Generator
211 SDMMC0 — SD/MMC Host Controller Interrupt 0
213 USBHS0 — High Speed USB Interrupt 0
215 HSM_TAMPER (HSM) — Hardware Security Module Tamper Interrupt
216 HSM_TXINT (HSM) — Hardware Security Module Transmit Interrupt
217 HSM_RXINT (HSM) — Hardware Security Module Receive Interrupt
218 MLB_GENERAL (MLB) — Media Local Bus General Interrupt
219 MLB_BUSREQ (MLB) — Media Local Bus Request Interrupt
220 CM7H_CTIIRQ_0 (CM7H) — Cross Trigger Interface Interrupt 0
221 CM7H_CTIIRQ_1 (CM7H) — Cross Trigger Interface Interrupt 1

## Event generators
1 SUPC_LVDET, 2 OSCCTRL_XOSC_FAIL, 3 OSC32KCTRL_XOSC32K_FAIL, 4 FREQM_DONE, 5 FREQM_WINMON, {n+6} RTC_PER_{n} (n=0..7), {n+14} RTC_CMP_{n} (n=0..3), 18 RTC_TAMPER, 19 RTC_OVF, 20 RTC_PERD, {n+21} EIC_EXTINT_{n} (n=0..15), 37 PAC_ACCERR, {n+38} DMA_CH_{n} (n=0..15), {11n+54} TCC{n}_OVF (n=0..2), {11n+55} TCC{n}_TRG (n=0..2), {11n+56} TCC{n}_CNT (n=0..2), {11n+57} TCC{n}_MC_0 (n=0..2), {11n+58} TCC{n}_MC_1 (n=0..2), {11n+59} TCC{n}_MC_2 (n=0..2), {11n+60} TCC{n}_MC_3 (n=0..2), {11n+61} TCC{n}_MC_4 (n=0..2), {11n+62} TCC{n}_MC_5 (n=0..2), 63 TCC0_MC_6, 64 TCC0_MC_7, 74 TCC1_MC_6, 75 TCC1_MC_7, {5n+70} TCC{n}_OVF (n=3..9), {5n+71} TCC{n}_TRG (n=3..9), {5n+72} TCC{n}_CNT (n=3..9), {5n+73} TCC{n}_MC_0 (n=3..9), {5n+74} TCC{n}_MC_1 (n=3..9), 120 TCC9_MC_2, 121 TCC9_MC_3, 122 TCC9_MC_4, 123 TCC9_MC_5, {n+124} ADC_CHRDYC_{n} (n=0..3), {n+128} ADC_CMP_{n} (n=0..3), 132 AC_COMP_0, 133 AC_COMP_1, 134 AC_WIN_0, 135 PTC_EOC, 136 PTC_WCOMP, 137 ETH_TSU_CMP, 138 TRNG_READY

## Event users
0 FREQM_START, 1 RTC_TAMPER, {n+2} PORT_EV_{n} (n=0..3), {n+6} DMA_CHSTRT_{n} (n=0..15), {n+22} DMA_CHAUX_{n} (n=0..15), {10n+38} TCC{n}_EV_0 (n=0..2), {10n+39} TCC{n}_EV_1 (n=0..2), {10n+40} TCC{n}_MC_0 (n=0..2), {10n+41} TCC{n}_MC_1 (n=0..2), {10n+42} TCC{n}_MC_2 (n=0..2), {10n+43} TCC{n}_MC_3 (n=0..2), {10n+44} TCC{n}_MC_4 (n=0..2), {10n+45} TCC{n}_MC_5 (n=0..2), 46 TCC0_MC_6, 47 TCC0_MC_7, 56 TCC1_MC_6, 57 TCC1_MC_7, {4n+54} TCC{n}_EV_0 (n=3..9), {4n+55} TCC{n}_EV_1 (n=3..9), {4n+56} TCC{n}_MC_0 (n=3..9), {4n+57} TCC{n}_MC_1 (n=3..9), 94 TCC9_MC_2, 95 TCC9_MC_3, 96 TCC9_MC_4, 97 TCC9_MC_5, {n+98} ADC_TRIGGERS_{n} (n=0..10), 109 AC_SOC_0, 110 AC_SOC_1, 111 PTC_DSEQR, 112 PTC_STCONV, {n+113} HSM_TAMPER_{n} (n=0..3)

## Properties
SIGNATURES: DSU_DID=0x09213053

## Pinouts (pin number, pad)
PIC32CZCA144B: A2 PD11, A3 PD10, A4 PD07, A5 PD21, A6 PD04, A7 PD15, A8 PD02, A9 PD01, A10 PD00, A11 USBID0, A12 VCCA3P30, A13 VBUS0, B1 PA01, B2 PD12, B3 PD09, B4 PD08, B5 VDDREG, B6 PD17, B7 PD16, B8 PC17, B9 PD13, B10 RESET_N, B11 USBRBIAS0, B12 VSSUSBA, B13 USBDM0, B14 USBDP0, C1 PA02, C2 PA00, C13 PC14, C14 PC29, D1 PA03, D2 PA04, D5 PD06, D6 PD19, D9 PD03, D10 PD14, D13 VSSF, D14 VDDF, E1 PA05, E2 PA06, E4 PA22, E5 PD20, E6 PD05, E7 VDDIO, E8 PD18, E9 PC18, E10 VDDREG, E11 PC15, E13 PC20, E14 PC19, F1 PA08, F2 PA07, F4 PA23, F5 PA21, F6 VDDIO, F7 VSS, F8 VDDIO, F9 VSSREG, F10 PC13, F11 PC12, F13 PC27, F14 PC28, G1 PA25, G2 PA24, G5 VDDIO, G6 VSS, G7 VSS15, G8 VSS14, G9 VDDIO, G10 PC26, G13 PC10, G14 PC11, H1 PA10, H2 PA09, H5 PB03, H6 VDDIO, H7 VSSUSBD, H8 VSS, H9 VSSF, H10 VDDIO, H13 PC25, H14 PC09, J1 PA27, J2 PA26, J4 PB01, J5 PB18, J6 VSS, J7 VDDIO, J8 VSS, J9 VDDIO, J10 PC24, J11 PC23, J13 PC07, J14 PC06, K1 PA11, K2 PA12, K4 PB02, K5 PB19, K6 PB06, K7 VSS, K8 VDDIO, K9 PB09, K10 PC08, K11 PC22, K13 PC21, K14 PC05, L1 PA13, L2 PA14, L5 PB20, L6 PB21, L9 PB10, L10 PB11, L13 PC04, L14 PC02, M1 PA28, M2 PA29, M13 PC03, M14 PC01, N1 PA17, N2 PA18, N3 PA16, N4 PB00, N5 AVDD, N6 PB05, N7 PB23, N8 PB08, N9 VDDREG, N10 PB26, N11 PB13, N12 PB15, N13 PB17, N14 PC00, P2 PA20, P3 PA15, P4 PA19, P5 AVSS, P6 PB04, P7 PB22, P8 PB07, P9 PB24, P10 PB25, P11 PB12, P12 PB14, P13 PB16
PIC32CZCA144DR: A1 PA00, A2 PA02, A3 PA03, A4 GND, A5 PA05, A6 PA21, A7 PA23, A8 PA09, A9 PA25, A10 VDDIO, A11 PA11, A12 PA27, A13 PA12, A14 PA14, A15 PA29, A16 GND, A17 PA16, A18 PA18, A19 PA19, A20 PA20, A21 PB00, A22 PB02, A23 PB18, A24 PB20, A25 AVSS, A26 PB04, A27 VDDIO, A28 PB21, A29 PB22, A30 PB23, A31 PB08, A32 GND, A33 PB10, A34 PB24, A35 PB26, A36 VDDREG, A37 VDDIO, A38 PB13, A39 PB15, A40 PB17, A41 PC00, A42 PC02, A43 PC04, A44 VDDF, A45 PC05, A46 PC21, A47 PC07, A48 PC23, A49 PC09, A50 VDDIO, A51 PC26, A52 PC11, A53 PC28, A54 PC13, A55 PC14, A56 VDDF, A57 RESET_N, A58 PC18, A59 PC19, A60 PC20, A61 USBDM0, A62 USBDP0, A63 USBID0, A64 USBRBIAS0, A65 GND, A66 PD01, A67 PD14, A68 PD03, A69 VDDIO, A70 PD16, A71 PD04, A72 PD19, A73 PD05, A74 PD20, A75 PD07, A76 GND, A77 VDDIO, A78 PD09, A79 PD11, A80 PD12, B1 PA01, B2 PA04, B3 VDDIO, B4 PA06, B5 PA22, B6 PA07, B7 PA08, B8 PA24, B9 GND, B10 PA10, B11 PA26, B12 PA13, B13 PA28, B14 PA15, B15 VDDIO, B16 PA17, B17 PB01, B18 PB03, B19 PB19, B20 AVDD, B21 PB05, B22 GND, B23 PB06, B24 PB07, B25 VDDIO, B26 PB09, B27 PB11, B28 PB25, B29 PB12, B30 GND, B31 PB14, B32 PB16, B33 PC01, B34 PC03, B35 VSSF2, B36 PC06, B37 PC22, B38 PC08, B39 PC24, B40 PC25, B41 GND, B42 PC10, B43 PC27, B44 PC12, B45 PC29, B46 PC15, B47 VSSF1, B48 PC17, B49 VCCA3P30, B50 VSSUSBA, B51 VBUS0, B52 VDDREG, B53 PD00, B54 PD13, B55 PD02, B56 GND, B57 PD15, B58 PD17, B59 PD18, B60 PD06, B61 PD21, B62 VDDREG, B63 PD08, B64 PD10
PIC32CZCA144: 1 PA00, 2 PA01, 3 PA02, 4 PA03, 5 PA04, 6 GND, 7 VDDIO, 8 PA05, 9 PA06, 10 PA21, 11 PA22, 12 PA23, 13 PA07, 14 PA08, 15 PA09, 16 PA24, 17 PA25, 18 GND, 19 VDDIO, 20 PA10, 21 PA11, 22 PA26, 23 PA27, 24 PA12, 25 PA13, 26 PA14, 27 PA28, 28 PA29, 29 PA15, 30 GND, 31 VDDIO, 32 PA16, 33 PA17, 34 PA18, 35 PA19, 36 PA20, 37 PB00, 38 PB01, 39 PB02, 40 PB03, 41 PB18, 42 PB19, 43 PB20, 44 AVSS, 45 AVDD, 46 PB04, 47 PB05, 48 VDDIO, 49 GND, 50 PB21, 51 PB06, 52 PB22, 53 PB23, 54 PB07, 55 PB08, 56 VDDIO, 57 GND, 58 PB09, 59 PB10, 60 PB11, 61 PB24, 62 PB25, 63 PB26, 64 PB12, 65 VDDREG, 66 GND, 67 VDDIO, 68 PB13, 69 PB14, 70 PB15, 71 PB16, 72 PB17, 73 PC00, 74 PC01, 75 PC02, 76 PC03, 77 PC04, 78 VDDF, 79 VSSF2, 80 PC05, 81 PC06, 82 PC21, 83 PC22, 84 PC07, 85 PC08, 86 PC23, 87 PC24, 88 PC09, 89 PC25, 90 VDDIO, 91 GND, 92 PC26, 93 PC10, 94 PC11, 95 PC27, 96 PC28, 97 PC12, 98 PC13, 99 PC29, 100 PC14, 101 PC15, 102 VDDF, 103 VSSF1, 104 RESET_N, 105 PC17, 106 PC18, 107 PC19, 108 PC20, 109 USBDM0, 110 USBDP0, 111 USBID0, 112 VCCA3P30, 113 VSSUSBA, 114 VBUS0, 115 USBRBIAS0, 116 GND, 117 VDDREG, 118 PD00, 119 PD01, 120 PD13, 121 PD14, 122 PD02, 123 PD03, 124 GND, 125 VDDIO, 126 PD15, 127 PD16, 128 PD17, 129 PD04, 130 PD18, 131 PD19, 132 PD05, 133 PD06, 134 PD20, 135 PD21, 136 PD07, 137 VDDREG, 138 GND, 139 VDDIO, 140 PD08, 141 PD09, 142 PD10, 143 PD11, 144 PD12

## Notices in the file
Copyright (c) 2021 Microchip Technology Inc.
SPDX-License-Identifier: Apache-2.0
Licensed under the Apache License, Version 2.0 (the "License");
you may not use this file except in compliance with the License.
You may obtain a copy of the License at
http://www.apache.org/licenses/LICENSE-2.0
Unless required by applicable law or agreed to in writing, software
distributed under the License is distributed on an "AS IS" BASIS,
WITHOUT WARRANTIES OR CONDITIONS OF ANY KIND, either express or implied.
See the License for the specific language governing permissions and
limitations under the License.
